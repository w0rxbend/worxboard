## firmware/zmk/Kconfig
```kconfig
# SPDX-License-Identifier: MIT
# worxboard ZMK module options (zephyr/module.yml -> kconfig: firmware/zmk/Kconfig)

config WORXBOARD_STATUS_SCREEN
    bool "worxboard status screen (both halves)"
    default y
    depends on ZMK_DISPLAY_STATUS_SCREEN_CUSTOM
    depends on BOARD_WORXBOARD_LEFT || BOARD_WORXBOARD_RIGHT || BOARD_WORXBOARD2_LEFT || BOARD_WORXBOARD2_RIGHT
    select LV_USE_LABEL
    select LV_FONT_MONTSERRAT_12
    select LV_FONT_MONTSERRAT_10
    help
      Portrait 32 x 128 screen for the 0.91" SSD1306 OLED (design.md §11.6). Central: logo, USB
      state, active layer and the Caps/Num/Scroll lock column. Peripheral: logo, the forwarded
      lock column and a static "wired" label. Uses no BLE or battery symbols.

choice WORXBOARD_DISPLAY_ROTATION
    prompt "worxboard display orientation"
    default WORXBOARD_DISPLAY_ROTATION_90
    depends on ZMK_DISPLAY
    depends on BOARD_WORXBOARD_LEFT || BOARD_WORXBOARD_RIGHT || BOARD_WORXBOARD2_LEFT || BOARD_WORXBOARD2_RIGHT
    help
      The 0.91" SSD1306 OLED (128 x 32) stands upright, so both halves lay their screen out
      portrait, 32 x 128, and src/worx_display_rotation.c turns it onto the panel.

config WORXBOARD_DISPLAY_ROTATION_90
    bool "Portrait, J3 header at the back (rev A mounting)"
    help
      LVGL LV_DISPLAY_ROTATION_90: the module's header points away from the user, as J3 holds it
      on both rev A boards. Assumes panel pixel (0, 0) is the top-left corner of the module seen
      glass up with its header on the left (not yet checked on hardware).

config WORXBOARD_DISPLAY_ROTATION_270
    bool "Portrait, turned 180 degrees from the rev A setting"
    help
      LVGL LV_DISPLAY_ROTATION_270. Use it if both screens come out upside down: the module's
      pixel (0, 0) is then at the other end from the one rev A assumes.

endchoice
```

## firmware/zmk/boards/worxbend/worxboard/Kconfig.worxboard_left
```kconfig
# SPDX-License-Identifier: MIT
config BOARD_WORXBOARD_LEFT
    select SOC_RP2040
    select ZMK_BOARD_COMPAT
    imply RETAINED_MEM
    imply RETENTION
    imply RETENTION_BOOT_MODE
```

## firmware/zmk/boards/worxbend/worxboard/Kconfig.worxboard_right
```kconfig
# SPDX-License-Identifier: MIT
config BOARD_WORXBOARD_RIGHT
    select SOC_RP2040
    select ZMK_BOARD_COMPAT
    imply RETAINED_MEM
    imply RETENTION
    imply RETENTION_BOOT_MODE
```

## firmware/zmk/boards/worxbend/worxboard/board.yml
```yaml
boards:
  - name: worxboard_left
    full_name: worxboard (left half)
    vendor: worxbend
    socs:
      - name: rp2040
        variants:
          - name: zmk
  - name: worxboard_right
    full_name: worxboard (right half)
    vendor: worxbend
    socs:
      - name: rp2040
        variants:
          - name: zmk
```

## firmware/zmk/boards/worxbend/worxboard2/Kconfig.defconfig
```kconfig
# SPDX-License-Identifier: MIT

if BOARD_WORXBOARD2_LEFT

config ZMK_KEYBOARD_NAME
    default "worxboard"

config ZMK_SPLIT_ROLE_CENTRAL
    default y

endif # BOARD_WORXBOARD2_LEFT

if BOARD_WORXBOARD2_LEFT || BOARD_WORXBOARD2_RIGHT

config BOARD
    default "worxboard"

config ZMK_SPLIT
    default y

if ZMK_DISPLAY

config LV_Z_VDB_SIZE
    default 100

config LV_DPI_DEF
    default 161

config LV_Z_BITS_PER_PIXEL
    default 1

choice LV_COLOR_DEPTH
    default LV_COLOR_DEPTH_1
endchoice

config LS0XX_VCOM_THREAD_PRIO
    default 11

choice ZMK_DISPLAY_WORK_QUEUE
    default ZMK_DISPLAY_WORK_QUEUE_DEDICATED
endchoice

config ZMK_DISPLAY_BLANK_ON_IDLE
    default n

endif # ZMK_DISPLAY

# Caps/Num/Scroll lock state is forwarded over the wired split to the right screen (§11.6)
config ZMK_HID_INDICATORS
    default y

config ZMK_SPLIT_PERIPHERAL_HID_INDICATORS
    default y

endif # BOARD_WORXBOARD2_LEFT || BOARD_WORXBOARD2_RIGHT

if BOARD_WORXBOARD2_RIGHT

# Right half: custom LVGL screen (firmware/zmk/src/worx_status_screen.c)
choice ZMK_DISPLAY_STATUS_SCREEN
    default ZMK_DISPLAY_STATUS_SCREEN_CUSTOM
endchoice

endif # BOARD_WORXBOARD2_RIGHT
```
