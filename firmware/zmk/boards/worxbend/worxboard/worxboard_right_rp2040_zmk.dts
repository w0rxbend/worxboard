/* SPDX-License-Identifier: MIT */
#include "worxboard.dtsi"

/ {
    model = "worxboard right";
    compatible = "worxbend,worxboard-right";
};

/* Both PCBs share one matrix netlist (COLn = physical column Cn, C0 outer). The right half is
 * mirrored, so its logical columns run inner -> outer: COL6..COL0 -> logical 0..6 -> global 7..13. */
&kscan0 {
    col-gpios
        = <&gpio0 20 GPIO_ACTIVE_HIGH>
        , <&gpio0 19 GPIO_ACTIVE_HIGH>
        , <&gpio0 18 GPIO_ACTIVE_HIGH>
        , <&gpio0 17 GPIO_ACTIVE_HIGH>
        , <&gpio0 16 GPIO_ACTIVE_HIGH>
        , <&gpio0 15 GPIO_ACTIVE_HIGH>
        , <&gpio0 14 GPIO_ACTIVE_HIGH>
        ;
};

&default_transform {
    col-offset = <7>;
};
